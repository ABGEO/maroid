## firmware/jasmine-node/main/Kconfig.projbuild
```kconfig
menu "WIFI Configuration"

    config ESP_WIFI_SSID
        string "WiFi SSID"
        default "myssid"
        help
            SSID (network name) to connect to.

    config ESP_WIFI_PASSWORD
        string "WiFi Password"
        default "mypassword"
        help
            WiFi password (WPA or WPA2).

    config ESP_MAXIMUM_RETRY
        int "Maximum retry"
        default 5
        help
            Maximum number of connection retries before giving up.

endmenu

menu "SNTP Configuration"

    config SNTP_TIME_SERVER
        string "SNTP server"
        default "pool.ntp.org"
        help
            Hostname of the main SNTP server.

endmenu

menu "MQTT Configuration"

    config MQTT_BROKER_URL
        string "MQTT broker URL"
        default "mqtt://localhost"
        help
            URL of the MQTT broker to connect to.

    config MQTT_USERNAME
        string "MQTT username"
        default ""
        help
            Username for MQTT broker authentication.

    config MQTT_PASSWORD
        string "MQTT password"
        default ""
        help
            Password for MQTT broker authentication.

    config MQTT_CONNECT_RETRIES
        int "MQTT connect retries"
        default 3
        range 1 10
        help
            Number of times to retry MQTT broker connection before giving up.

endmenu

menu "Node Configuration"

    choice NODE_TYPE
        prompt "Node type"
        default NODE_TYPE_PLANT
        help
            Select the type of sensor node. Affects MQTT topic hierarchy
            so the backend knows which entity type to create.

        config NODE_TYPE_ENVIRONMENT
            bool "Environment"
            help
                Environment node monitors a room or outdoor area.
                Default sensors: BH1750 (light), DHT (temperature/humidity).

        config NODE_TYPE_PLANT
            bool "Plant"
            help
                Plant node monitors a specific plant.
                Default sensor: soil moisture.
    endchoice

    config NODE_ID
        string "Node ID"
        default "N001"
        help
            Unique identifier for this node.
            Used in MQTT topics and as a suffix for the MQTT client ID.

    config SLEEP_DURATION_SEC
        int "Deep sleep duration (seconds)"
        default 60
        range 1 3600
        help
            Duration to stay in deep sleep between sensor readings.

endmenu

menu "Sensor Configuration"

    config SENSOR_BH1750_ENABLED
        bool "Enable BH1750 light sensor"
        default y if NODE_TYPE_ENVIRONMENT
        default n if NODE_TYPE_PLANT
        help
            Enable the BH1750 ambient light sensor (I2C).

    menu "BH1750 Configuration"
        visible if SENSOR_BH1750_ENABLED

        config I2C_MASTER_SCL_IO
            int "I2C master SCL GPIO number"
            default 18
            help
                GPIO number used for I2C master clock line (SCL).

        config I2C_MASTER_SDA_IO
            int "I2C master SDA GPIO number"
            default 19
            help
                GPIO number used for I2C master data line (SDA).

    endmenu

    config SENSOR_DHT_ENABLED
        bool "Enable DHT temperature/humidity sensor"
        default y if NODE_TYPE_ENVIRONMENT
        default n if NODE_TYPE_PLANT
        help
            Enable the DHT/AM2301 temperature and humidity sensor (GPIO).

    menu "DHT Configuration"
        visible if SENSOR_DHT_ENABLED

        config DHT_DATA_GPIO
            int "DHT sensor data GPIO number"
            default 23
            help
                GPIO number used for DHT sensor data line.

    endmenu

    config SENSOR_SOIL_MOISTURE_ENABLED
        bool "Enable soil moisture sensor"
        default n if NODE_TYPE_ENVIRONMENT
        default y if NODE_TYPE_PLANT
        help
            Enable the capacitive soil moisture sensor (ADC).

    menu "Soil Moisture Configuration"
        visible if SENSOR_SOIL_MOISTURE_ENABLED

        config SOIL_MOISTURE_ADC1_CH
            int "ADC1 Channel"
            default 6

        config SOIL_MOISTURE_SAMPLE_COUNT
            int "Number of ADC samples to average"
            default 64
            help
                Number of ADC readings to take and average per measurement cycle.

        config SOIL_MOISTURE_SAMPLE_DELAY_MS
            int "Delay between samples (ms)"
            default 2
            help
                Milliseconds to wait between consecutive ADC samples.
                Reduces noise coupling. Set to 0 to disable.

        config SOIL_MOISTURE_VALID_MIN
            int "Minimum valid raw ADC value"
            default 0
            help
                Raw ADC readings below this value are discarded as invalid.

        config SOIL_MOISTURE_VALID_MAX
            int "Maximum valid raw ADC value"
            default 4095
            help
                Raw ADC readings above this value are discarded as invalid.

        config SOIL_MOISTURE_CAL_AIR_VALUE
            int "Calibration: dry air ADC reading (0% moisture)"
            default 3000
            help
                Raw ADC value when sensor is in dry air. Calibrate by reading
                the raw value with the sensor exposed to air.

        config SOIL_MOISTURE_CAL_WATER_VALUE
            int "Calibration: water ADC reading (100% moisture)"
            default 1000
            help
                Raw ADC value when sensor is submerged in water. Calibrate by
                reading the raw value with the sensor in water.

    endmenu

    config SENSOR_MQ135_ENABLED
        bool "Enable MQ-135 air quality sensor"
        default n
        help
            Enable the MQ-135 gas sensor for CO2 measurement (ADC).

    menu "MQ-135 Configuration"
        visible if SENSOR_MQ135_ENABLED

        config MQ135_ADC1_CH
            int "ADC1 Channel"
            default 7

        config MQ135_SAMPLE_COUNT
            int "Number of ADC samples to average"
            default 64
            help
                Number of ADC readings to take and average per measurement cycle.

        config MQ135_SAMPLE_DELAY_MS
            int "Delay between samples (ms)"
            default 2
            help
                Milliseconds to wait between consecutive ADC samples.
                Reduces noise coupling. Set to 0 to disable.

        config MQ135_VALID_MIN
            int "Minimum valid raw ADC value"
            default 0
            help
                Raw ADC readings below this value are discarded as invalid.

        config MQ135_VALID_MAX
            int "Maximum valid raw ADC value"
            default 4095
            help
                Raw ADC readings above this value are discarded as invalid.

        config MQ135_PREHEAT_MS
            int "Sensor preheat delay (ms)"
            default 30000
            help
                Warmup delay before first reading after power-on.
                MQ-135 needs time to stabilize. 30000 (30s) is a practical
                minimum for trend monitoring from cold start.

        config MQ135_RL_KOHM_X100
            int "Load resistance RL (kOhm x100)"
            default 100
            help
                Load resistance on the MQ-135 module in kOhm multiplied by 100.
                Example: 1.0 kOhm = 100, 10.0 kOhm = 1000.
                Check your module's PCB for the actual value.

        config MQ135_R0_X100
            int "Calibrated R0 (x100)"
            default 1000
            help
                Baseline sensor resistance in clean air, multiplied by 100.
                Example: 10.0 = 1000. Must be calibrated: power sensor in
                clean air for 24-48h, compute R0 = RS / 3.6.

        config MQ135_VOLTAGE_REF_MV
            int "ADC reference voltage (mV)"
            default 3300
            help
                ADC reference voltage in millivolts. 3300 for standard ESP32.

    endmenu

endmenu
```
